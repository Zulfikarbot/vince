## drivers/input/fingerprint/Kconfig
```kconfig
config INPUT_FINGERPRINT
	tristate "Fingerprint driver support"
	help
	  Say Y here to enable goodix fingerprint driver support!
source "drivers/input/fingerprint/goodix_mido/Kconfig"
source "drivers/input/fingerprint/fpc_mido/Kconfig"
source "drivers/input/fingerprint/goodix_tissot/Kconfig"
source "drivers/input/fingerprint/fpc_tissot/Kconfig"
source "drivers/input/fingerprint/goodix_vince/Kconfig"
source "drivers/input/fingerprint/fpc_vince/Kconfig"
```

## drivers/input/fingerprint/fpc_vince/Kconfig
```kconfig
config FINGERPRINT_FPC1020_VINCE
	tristate "FingerPrint Cards fingerprint drvier support"
	depends on INPUT_FINGERPRINT
	help
	  Say Y here to enable goodix fingerprint driver support!
```

## drivers/input/fingerprint/goodix_vince/Kconfig
```kconfig
config FINGERPRINT_GOODIX_GF3208_VINCE
	tristate "Goodix GF3208 fingerprint drvier support"
	depends on INPUT_FINGERPRINT
	help
	  Say Y here to enable goodix fingerprint driver support!
```
